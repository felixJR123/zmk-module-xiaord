## Kconfig
```kconfig
# Copyright (c) 2024 Custom configuration
# SPDX-License-Identifier: Apache-2.0

rsource "drivers/Kconfig"
```

## boards/shields/xiaord/Kconfig.shield
```kconfig
# Copyright (c) 2021 The ZMK Contributors
# SPDX-License-Identifier: MIT

config SHIELD_XIAORD
    def_bool $(shields_list_contains,xiaord)
```

## drivers/input/Kconfig
```kconfig
config ZMK_VIRTUAL_KEY_SOURCE
	bool "Virtual key source input device"
	default y
	depends on DT_HAS_ZMK_VIRTUAL_KEY_SOURCE_ENABLED
```

## dts/bindings/behaviors/zmk,behavior-xiaord-home-datetime.yaml
```yaml
description: Toggle the Xiaord home screen date and time widgets
compatible: "zmk,behavior-xiaord-home-datetime"
include: zero_param.yaml
properties:
  "#binding-cells":
    type: int
    const: 0
```

## dts/bindings/behaviors/zmk,behavior-xiaord-home-info.yaml
```yaml
description: Toggle the Xiaord home screen information widgets
compatible: "zmk,behavior-xiaord-home-info"
include: zero_param.yaml
properties:
  "#binding-cells":
    type: int
    const: 0
```

## dts/bindings/behaviors/zmk,behavior-xiaord-menu.yaml
```yaml
description: Toggle the Xiaord home screen shortcut button ring
compatible: "zmk,behavior-xiaord-menu"
include: zero_param.yaml
properties:
  "#binding-cells":
    type: int
    const: 0
```

## dts/bindings/input/chipsemi,chsc6x-custom.yaml
```yaml
# Copyright (c) 2024 Custom CHSC6X driver
# SPDX-License-Identifier: Apache-2.0

description: ChipSemi CHSC6X touchpad controller (custom version)

compatible: "chipsemi,chsc6x-custom"

include: [i2c-device.yaml]

properties:
  irq-gpios:
    type: phandle-array
    required: true
    description: |
      Interrupt GPIO pin connected to the CHSC6X controller.
      This pin is used to signal touch events.
```

## dts/bindings/input_processors/zmk,input-processor-code-canceller.yaml
```yaml
# Copyright (c) 2024, The ZMK Contributors
# SPDX-License-Identifier: MIT

description: Input Processor for cancelling (suppressing) specific input codes

compatible: "zmk,input-processor-code-canceller"

include: ip_zero_param.yaml

properties:
  type:
    type: int
    required: true
  codes:
    type: array
    required: true
```

## dts/bindings/xiaord,home-buttons.yaml
```yaml
description: |
  Home screen circle button ring configuration.

  Defines which of the 12 fixed clock-position slots are populated,
  what icon they display, and whether they navigate to another page on tap.

  Example:

    home_buttons {
        compatible = "xiaord,home-buttons";

        btn_upload {
            position = <0>;
            symbol = <ICON_UPLOAD>;
        };
        btn_bt {
            position = <9>;
            symbol = <ICON_BLUETOOTH>;
            nav-page = <XIAORD_PAGE_BT>;
        };
    };

compatible: "xiaord,home-buttons"

child-binding:
  description: Single button in the home screen circle ring.
  properties:
    position:
      type: int
      required: true
      description: >
        Clock-position slot index (0–11). 0 = 12 o'clock, 1 = 1 o'clock,
        clockwise in 30-degree steps.

    symbol:
      type: int
      required: true
      description: >
        Unicode codepoint of the icon glyph.
        Use ICON_* constants from dt-bindings/xiaord/icons.h.

    nav-page:
      type: int
      description: >
        XIAORD_PAGE_* index to navigate to on tap. Omit for no navigation.

    dismiss:
      type: boolean
      description: >
        If true, hide the button ring on tap.
```

## dts/bindings/zmk,virtual-key-source.yaml
```yaml
description: Virtual key source input device

compatible: "zmk,virtual-key-source"

# No hardware input phandle — key events are emitted via input_report_key()
# from the display layer (status_screen.c → ss_send_key()).
```

## dts/bindings/zmk,virtual-pointer.yaml
```yaml
description: Virtual touch-to-pointer input converter

compatible: "zmk,virtual-pointer"

# No hardware input phandle — touch frames are fed via
# zmk_virtual_pointer_feed() from the display layer (status_screen.c).
```

## src/display/Kconfig
```kconfig
menu "Xiaord display options"

config XIAORD_BG_1
    bool "Background 1"
    default y if !XIAORD_BG_2 && !XIAORD_BG_3 && !XIAORD_BG_4

config XIAORD_BG_2
    bool "Background 2"
    default n

config XIAORD_BG_3
    bool "Background 3"
    default n

config XIAORD_BG_4
    bool "Keyboard repo custom background"
    default n
    help
      Enable the custom background slot. The build will use an existing local
      src/display/ui/bg/bg4.c when present. Otherwise, it will try to generate
      bg4.c from XIAORD_BG_4_SOURCE_DIR, the XIAORD_BG_4_SOURCE_DIR
      environment variable, or the default xiaord-bg folder in the keyboard
      config repo. If no image is available, the firmware falls back to
      Background 1 so public builds still compile.

config XIAORD_BG_4_SOURCE_DIR
    string "Custom background source picture folder"
    default ""
    depends on XIAORD_BG_4
    help
      Optional folder containing JPG/PNG files. Relative paths are resolved
      from the keyboard config repo. When XIAORD_BG_4 is enabled and bg4.c is
      missing, the build uses the first image in this folder to generate bg4.c
      and bg4.png. Leave empty to use xiaord-bg in the keyboard config repo,
      use the XIAORD_BG_4_SOURCE_DIR environment variable, or fall back to
      Background 1.

config XIAORD_BG_SD
    bool "SD card backgrounds"
    default n
    select DISK_ACCESS
    select FILE_SYSTEM
    select FAT_FILESYSTEM_ELM
    help
      Load 240x240 RGB565 background files from the microSD card instead of
      compiling photos into the firmware. Files are expected to be generated by
      tools/xiaord_sd_backgrounds.py and stored as bg001.rgb565, bg002.rgb565,
      etc. The firmware keeps only one active image in RAM and falls back to
      the selected compiled background if the SD card or converted files are
      unavailable.

config XIAORD_BG_SD_MOUNT_POINT
    string "SD card mount point"
    default "/SD:"
    depends on XIAORD_BG_SD
    help
      Filesystem mount point for the SD card.

config XIAORD_BG_SD_DIR
    string "SD card converted background directory"
    default "/xiaord-bg/converted"
    depends on XIAORD_BG_SD
    help
      Directory under the mount point containing bg001.rgb565, bg002.rgb565,
      etc.

config XIAORD_BG_SD_MAX_FILES
    int "Maximum SD backgrounds to index"
    default 999
    range 1 999
    depends on XIAORD_BG_SD
    help
      Maximum number of SD-card background files to scan and cycle through.

config XIAORD_BG_SD_ROTATE_MS
    int "SD background auto-rotate timeout in milliseconds"
    default 0
    range 0 86400000
    depends on XIAORD_BG_SD
    help
      Automatically advance to the next SD-card background after this many
      milliseconds. Set to 0 to disable automatic rotation.

config XIAORD_BG_SD_GESTURES
    bool "Use left/right slide gestures for SD backgrounds"
    default y
    depends on XIAORD_BG_SD
    help
      When enabled, slide left/right on the home screen cycle SD-card
      backgrounds instead of firing the normal left/right gesture bindings.

config XIAORD_BG_5
    bool "Deprecated custom background 2 (ignored)"
    default n
    help
      Deprecated compatibility option. Custom backgrounds now use only
      XIAORD_BG_4. This option is accepted so older keyboard configs that still
      set CONFIG_XIAORD_BG_5=n or y do not fail Kconfig parsing.

config XIAORD_BG_6
    bool "Deprecated custom background 3 (ignored)"
    default n
    help
      Deprecated compatibility option. Custom backgrounds now use only
      XIAORD_BG_4. This option is accepted so older keyboard configs that still
      set CONFIG_XIAORD_BG_6=n or y do not fail Kconfig parsing.

config XIAORD_REMOVE_DATE_TIME
    bool "Remove date/time from home screen"
    default n
    help
      Remove the home screen date and time labels for cleaner photo backgrounds.
      The clock settings page remains available.

config XIAORD_DOUBLE_TAP_MS
    int "Home screen double-tap timeout in milliseconds"
    default 450
    range 100 2000
    help
      Maximum time between home screen taps to count as a double tap. Increase
      this if opening the shortcut button ring feels too difficult.

endmenu
```

## xiaord_example/boards/shields/sample_split/Kconfig.defconfig
```kconfig
# Copyright (c) 2021 The ZMK Contributors
# SPDX-License-Identifier: MIT

if SHIELD_SAMPLE_SPLIT_LEFT || SHIELD_SAMPLE_SPLIT_RIGHT || SHIELD_SAMPLE_SPLIT_DONGLE
    config ZMK_SPLIT
        default y
    config ZMK_KEYBOARD_NAME
        default "Sample Split"
endif

if SHIELD_SAMPLE_SPLIT_DONGLE
    config ZMK_SPLIT_ROLE_CENTRAL
        default y

    config ZMK_SPLIT_BLE_CENTRAL_PERIPHERALS
        default 2

    # Set this to ZMK_SPLIT_BLE_CENTRAL_PERIPHERALS + your desired number of BT profiles (default is 5)
    config BT_MAX_CONN
        default 7

    # Set this to the same number as BT_MAX_CONN
    config BT_MAX_PAIRED
        default 7

endif
```

## xiaord_example/boards/shields/sample_split/Kconfig.shield
```kconfig
# Copyright (c) 2021 The ZMK Contributors
# SPDX-License-Identifier: MIT

config SHIELD_SAMPLE_SPLIT_LEFT
    def_bool $(shields_list_contains,sample_split_left)

config SHIELD_SAMPLE_SPLIT_RIGHT
    def_bool $(shields_list_contains,sample_split_right)

config SHIELD_SAMPLE_SPLIT_DONGLE
    def_bool $(shields_list_contains,sample_split_dongle)
```
