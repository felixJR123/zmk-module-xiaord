/*
 * SPDX-License-Identifier: MIT
 *
 * Input processor mapping INPUT_EV_ZMK_BEHAVIORS codes to ZMK BT behaviors.
 * Include this file from your keyboard overlay and add &zmk_behaviors to
 * the input-processors list of the touchpad_listener (or any input-listener
 * connected to the xiaord virtual-key source).
 *
 * Required Kconfig:
 *   CONFIG_ZMK_BLE=y                   — &bt * behaviors
 *   CONFIG_ZMK_OUTPUT_SELECTION=y      — &out * behaviors
 *
 * Note: INPUT_VIRTUAL_ZMK_BT_CLR_0..11 codes are defined in input_codes.h
 * but have no bindings here. Per-profile CLR requires SEL+CLR (two actions),
 * which cannot be expressed as a single input-processor entry. Define them
 * via macros in your keyboard overlay if needed.
 */

#include <dt-bindings/zmk/bt.h>
#include <dt-bindings/zmk/keys.h>
#include <dt-bindings/zmk/mouse.h>
#include <dt-bindings/zmk/outputs.h>
#include <dt-bindings/xiaord/input_codes.h>

/ {
    virtual_zmk_behavior: virtual_zmk_behavior {
        compatible = "zmk,input-processor-behaviors";
        #input-processor-cells = <0>;
        type = <INPUT_EV_ZMK_BEHAVIORS>;
        codes = <
            INPUT_VIRTUAL_ZMK_BT_CLR        INPUT_VIRTUAL_ZMK_BT_CLR_ALL
            INPUT_VIRTUAL_ZMK_BT_NXT        INPUT_VIRTUAL_ZMK_BT_PRV
            INPUT_VIRTUAL_ZMK_OUT_USB       INPUT_VIRTUAL_ZMK_OUT_BLE
            INPUT_VIRTUAL_ZMK_OUT_TOG
            INPUT_VIRTUAL_ZMK_BT_SEL_0      INPUT_VIRTUAL_ZMK_BT_SEL_1
            INPUT_VIRTUAL_ZMK_BT_SEL_2      INPUT_VIRTUAL_ZMK_BT_SEL_3
            INPUT_VIRTUAL_ZMK_BT_SEL_4      INPUT_VIRTUAL_ZMK_BT_SEL_5
            INPUT_VIRTUAL_ZMK_BT_SEL_6      INPUT_VIRTUAL_ZMK_BT_SEL_7
            INPUT_VIRTUAL_ZMK_BT_SEL_8      INPUT_VIRTUAL_ZMK_BT_SEL_9
            INPUT_VIRTUAL_ZMK_BT_SEL_10     INPUT_VIRTUAL_ZMK_BT_SEL_11
        >;
        bindings = <
            &bt BT_CLR     &bt BT_CLR_ALL
            &bt BT_NXT     &bt BT_PRV
            &out OUT_USB   &out OUT_BLE
            &out OUT_TOG
            &bt BT_SEL 0   &bt BT_SEL 1
            &bt BT_SEL 2   &bt BT_SEL 3
            &bt BT_SEL 4   &bt BT_SEL 5
            &bt BT_SEL 6   &bt BT_SEL 7
            &bt BT_SEL 8   &bt BT_SEL 9
            &bt BT_SEL 10  &bt BT_SEL 11
        >;
    };

    virtual_symbol_behavior: virtual_symbol_behavior {
        compatible = "zmk,input-processor-behaviors";
        #input-processor-cells = <0>;
        type = <INPUT_EV_ZMK_BEHAVIORS>;
        codes = <
            INPUT_VIRTUAL_POS_0    INPUT_VIRTUAL_POS_1
            INPUT_VIRTUAL_POS_2    INPUT_VIRTUAL_POS_3
            INPUT_VIRTUAL_POS_4    INPUT_VIRTUAL_POS_5
            INPUT_VIRTUAL_POS_6    INPUT_VIRTUAL_POS_7
            INPUT_VIRTUAL_POS_8    INPUT_VIRTUAL_POS_9
            INPUT_VIRTUAL_POS_10   INPUT_VIRTUAL_POS_11
            INPUT_VIRTUAL_SCROLL_CW   INPUT_VIRTUAL_SCROLL_CCW
        >;
        bindings = <
            &bootloader            &kp PRINTSCREEN
            &kp C_VOL_UP           &kp C_MUTE
            &kp C_VOL_DN           &kp C_NEXT
            &kp C_PLAY             &kp C_PREV
            &kp LC(LA(DEL))        &out OUT_USB
            &out OUT_BLE           &none
            &msc MOVE_Y(-10)       &msc MOVE_Y(10)
        >;
    };
};
